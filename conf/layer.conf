## conf/layer.conf
```bitbake
# We have a conf and classes directory, add to BBPATH
BBPATH .= ":${LAYERDIR}"

# We have recipes-* directories, add to BBFILES
BBFILES += "${LAYERDIR}/recipes-*/*/*.bb \
            ${LAYERDIR}/recipes-*/*/*.bbappend"

BBFILE_COLLECTIONS += "8bitrobots"
BBFILE_PATTERN_8bitrobots = "^${LAYERDIR}/"
BBFILE_PRIORITY_8bitrobots = "99"
LAYERVERSION_8bitrobots = "1"
```
